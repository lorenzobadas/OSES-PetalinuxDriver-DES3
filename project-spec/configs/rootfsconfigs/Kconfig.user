## project-spec/configs/rootfsconfigs/Kconfig.user
```kconfig
menu "user packages " 
config des3app  
	 bool "des3app"
	 help
	
config des3module  
	 bool "des3module"
	 help
	
config gpio-demo  
	 bool "gpio-demo"
	 help
	
config peekpoke  
	 bool "peekpoke"
	 help
	
endmenu
```
